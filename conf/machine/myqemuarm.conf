## conf/machine/myqemuarm.conf
```bitbake
#@TYPE: Machine
#@NAME: myqemuarm

#@DESCRIPTION: Machine configuration for myqemuarm systems


PREFERRED_PROVIDER_virtual/kernel ?= "linux-yocto"
PREFERRED_VERSION_linux-yocto ?= "4.4%"


require conf/machine/include/qemu.inc
require conf/machine/include/tune-arm926ejs.inc


KERNEL_IMAGETYPE = "zImage"
SERIAL_CONSOLE = "115200 ttyAMA0"
```
